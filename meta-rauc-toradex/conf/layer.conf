## meta-rauc-toradex/conf/layer.conf
```bitbake
# We have a conf and classes directory, add to BBPATH
BBPATH .= ":${LAYERDIR}"

# We have recipes-* directories, add to BBFILES
BBFILES += "${LAYERDIR}/recipes-*/*/*.bb \
            ${LAYERDIR}/recipes-*/*/*.bbappend"

BBFILE_COLLECTIONS += "meta-rauc-toradex"
BBFILE_PATTERN_meta-rauc-toradex = "^${LAYERDIR}/"
BBFILE_PRIORITY_meta-rauc-toradex = "6"

LAYERDEPENDS_meta-rauc-toradex = "core rauc toradex-bsp-common-layer"
LAYERSERIES_COMPAT_meta-rauc-toradex = "kirkstone"
```
